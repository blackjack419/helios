## configs/beaglebone_buildroot_defconfig
```kconfig
BR2_arm=y
BR2_cortex_a8=y
BR2_ARM_FPU_VFPV3=y
BR2_ARM_INSTRUCTIONS_THUMB2=y
BR2_JLEVEL=2
BR2_CCACHE=y
BR2_CCACHE_DIR="$(TOPDIR)/../.cache"
BR2_OPTIMIZE_2=y
BR2_PACKAGE_OVERRIDE_FILE="$(BR2_EXTERNAL_HELIOS_PATH)/board/beaglebone/local.mk"
BR2_GLOBAL_PATCH_DIR="$(BR2_EXTERNAL_HELIOS_PATH)/patches"
BR2_SSP_ALL=y
BR2_TOOLCHAIN_BUILDROOT_MUSL=y
BR2_PACKAGE_HOST_LINUX_HEADERS_CUSTOM_5_10=y
BR2_TOOLCHAIN_BUILDROOT_CXX=y
BR2_GCC_ENABLE_LTO=y
BR2_PACKAGE_HOST_GDB=y
BR2_PACKAGE_HOST_GDB_TUI=y
BR2_GDB_VERSION_10=y
BR2_TARGET_GENERIC_HOSTNAME="HeliOS"
BR2_TARGET_GENERIC_ISSUE="HeliOS - Telemetry Remastered"
BR2_TARGET_GENERIC_PASSWD_SHA512=y
BR2_INIT_OPENRC=y
BR2_ROOTFS_DEVICE_CREATION_DYNAMIC_EUDEV=y
BR2_ROOTFS_DEVICE_TABLE="system/device_table.txt $(BR2_EXTERNAL_HELIOS_PATH)/board/common/device_table.txt"
BR2_ROOTFS_MERGED_USR=y
# BR2_TARGET_ENABLE_ROOT_LOGIN is not set
BR2_SYSTEM_BIN_SH_BASH=y
BR2_TARGET_GENERIC_GETTY_BAUDRATE_115200=y
BR2_TARGET_GENERIC_GETTY_TERM="linux"
# BR2_TARGET_GENERIC_REMOUNT_ROOTFS_RW is not set
BR2_SYSTEM_DEFAULT_PATH="/bin:/sbin:/usr/bin:/usr/sbin"
BR2_TARGET_TZ_INFO=y
BR2_ROOTFS_USERS_TABLES="$(BR2_EXTERNAL_HELIOS_PATH)/board/common/users_table.txt"
BR2_ROOTFS_OVERLAY="$(BR2_EXTERNAL_HELIOS_PATH)/board/common/rootfs_overlay"
BR2_ROOTFS_POST_BUILD_SCRIPT="$(BR2_EXTERNAL_HELIOS_PATH)/board/common/post_build.sh"
BR2_ROOTFS_POST_IMAGE_SCRIPT="support/scripts/genimage.sh"
BR2_ROOTFS_POST_SCRIPT_ARGS="${HELIOS_VERSION} -c $(BR2_EXTERNAL_HELIOS_PATH)/board/beaglebone/genimage.cfg"
BR2_LINUX_KERNEL=y
BR2_LINUX_KERNEL_CUSTOM_GIT=y
BR2_LINUX_KERNEL_CUSTOM_REPO_URL="https://github.com/beagleboard/linux.git"
BR2_LINUX_KERNEL_CUSTOM_REPO_VERSION="5.10.100-ti-r37"
BR2_LINUX_KERNEL_USE_CUSTOM_CONFIG=y
BR2_LINUX_KERNEL_CUSTOM_CONFIG_FILE="$(BR2_EXTERNAL_HELIOS_PATH)/board/beaglebone/linux.config"
BR2_LINUX_KERNEL_LZ4=y
BR2_LINUX_KERNEL_DTS_SUPPORT=y
BR2_LINUX_KERNEL_CUSTOM_DTS_PATH="$(BR2_EXTERNAL_HELIOS_PATH)/board/beaglebone/dts/am335x-boneblack-helios.dts"
BR2_LINUX_KERNEL_DTB_OVERLAY_SUPPORT=y
BR2_LINUX_KERNEL_NEEDS_HOST_OPENSSL=y
BR2_PACKAGE_LINUX_TOOLS_CPUPOWER=y
BR2_PACKAGE_LINUX_TOOLS_GPIO=y
BR2_PACKAGE_BUSYBOX_CONFIG="$(BR2_EXTERNAL_HELIOS_PATH)/board/beaglebone/busybox.config"
BR2_PACKAGE_AM335X_PRU_PACKAGE=y
BR2_PACKAGE_STM32FLASH=y
BR2_PACKAGE_OPENRESOLV=y
BR2_PACKAGE_OPENSSH=y
BR2_PACKAGE_URANDOM_SCRIPTS=y
BR2_PACKAGE_BASH_COMPLETION=y
BR2_PACKAGE_LOGROTATE=y
BR2_PACKAGE_SUDO=y
BR2_PACKAGE_HTOP=y
BR2_PACKAGE_START_STOP_DAEMON=y
BR2_PACKAGE_UTIL_LINUX_BINARIES=y
BR2_PACKAGE_UTIL_LINUX_AGETTY=y
BR2_PACKAGE_UTIL_LINUX_MOUNT=y
BR2_PACKAGE_WATCHDOG=y
BR2_PACKAGE_NANO=y
# BR2_PACKAGE_NANO_TINY is not set
BR2_PACKAGE_VIM=y
BR2_TARGET_ROOTFS_EXT2=y
BR2_TARGET_ROOTFS_EXT2_4=y
BR2_TARGET_ROOTFS_EXT2_SIZE="128M"
BR2_TARGET_BAREBOX=y
BR2_TARGET_BAREBOX_CUSTOM_VERSION=y
BR2_TARGET_BAREBOX_CUSTOM_VERSION_VALUE="2021.08.0"
BR2_TARGET_BAREBOX_USE_CUSTOM_CONFIG=y
BR2_TARGET_BAREBOX_CUSTOM_CONFIG_FILE="$(BR2_EXTERNAL_HELIOS_PATH)/board/beaglebone/barebox.config"
BR2_TARGET_BAREBOX_IMAGE_FILE="images/barebox-am33xx-beaglebone.img"
BR2_TARGET_BAREBOX_BAREBOXENV=y
BR2_TARGET_BAREBOX_CUSTOM_ENV=y
BR2_TARGET_BAREBOX_CUSTOM_ENV_PATH="$(BR2_EXTERNAL_HELIOS_PATH)/board/beaglebone/barebox.env"
BR2_TARGET_BAREBOX_CUSTOM_EMBEDDED_ENV_PATH="$(BR2_EXTERNAL_HELIOS_PATH)/board/common/barebox.env"
BR2_TARGET_BAREBOX_AUX=y
BR2_TARGET_BAREBOX_AUX_USE_CUSTOM_CONFIG=y
BR2_TARGET_BAREBOX_AUX_CUSTOM_CONFIG_FILE="$(BR2_EXTERNAL_HELIOS_PATH)/board/beaglebone/barebox-mlo.config"
BR2_TARGET_BAREBOX_AUX_IMAGE_FILE="images/barebox-am33xx-beaglebone-mlo.img"
BR2_PACKAGE_HOST_DOSFSTOOLS=y
BR2_PACKAGE_HOST_GENIMAGE=y
BR2_PACKAGE_HOST_MTOOLS=y
```
